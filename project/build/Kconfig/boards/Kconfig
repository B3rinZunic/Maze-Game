## project/build/Kconfig/boards/Kconfig
```kconfig
# Load Zephyr board Kconfig descriptions.
osource "C:/zephyrproject/zephyr/boards/st/nucleo_f411re/Kconfig"
```

## project/build/Kconfig/boards/Kconfig.defconfig
```kconfig
# Load Zephyr board defconfig descriptions.
osource "C:/zephyrproject/zephyr/boards/st/nucleo_f411re/Kconfig.defconfig"
```

## project/build/Kconfig/boards/Kconfig.nucleo_f411re
```kconfig
# Load board Kconfig descriptions.
osource "C:/zephyrproject/zephyr/boards/st/nucleo_f411re/Kconfig.nucleo_f411re"
```
